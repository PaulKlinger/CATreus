/*
 * Copyright (c) 2023 Nordic Semiconductor ASA
 * SPDX-License-Identifier: LicenseRef-Nordic-5-Clause
 */

.param_1 = {0.0, 0.005, 0.01, 0.015, 0.02, 0.025, 0.03, 0.035, 0.04, 0.045, 0.05, 0.055, 0.06, 0.065, 0.07, 0.075, 0.08, 0.085, 0.09, 0.095, 0.1, 0.105, 0.11, 0.115, 0.12, 0.125, 0.13, 0.135, 0.14, 0.145, 0.15, 0.155, 0.16, 0.165, 0.17, 0.17500000000000002, 0.18, 0.185, 0.19, 0.195, 0.2, 0.20500000000000002, 0.21, 0.215, 0.22, 0.225, 0.23, 0.23500000000000001, 0.24, 0.245, 0.25, 0.255, 0.26, 0.265, 0.27, 0.275, 0.28, 0.28500000000000003, 0.29, 0.295, 0.3, 0.305, 0.31, 0.315, 0.32, 0.325, 0.33, 0.335, 0.34, 0.34500000000000003, 0.35000000000000003, 0.355, 0.36, 0.365, 0.37, 0.375, 0.38, 0.385, 0.39, 0.395, 0.4, 0.405, 0.41000000000000003, 0.41500000000000004, 0.42, 0.425, 0.43, 0.435, 0.44, 0.445, 0.45, 0.455, 0.46, 0.465, 0.47000000000000003, 0.47500000000000003, 0.48, 0.485, 0.49, 0.495, 0.5, 0.505, 0.51, 0.515, 0.52, 0.525, 0.53, 0.535, 0.54, 0.545, 0.55, 0.555, 0.56, 0.5650000000000001, 0.5700000000000001, 0.5750000000000001, 0.58, 0.585, 0.59, 0.595, 0.6, 0.605, 0.61, 0.615, 0.62, 0.625, 0.63, 0.635, 0.64, 0.645, 0.65, 0.655, 0.66, 0.665, 0.67, 0.675, 0.68, 0.685, 0.6900000000000001, 0.6950000000000001, 0.7000000000000001, 0.705, 0.71, 0.715, 0.72, 0.725, 0.73, 0.735, 0.74, 0.745, 0.75, 0.755, 0.76, 0.765, 0.77, 0.775, 0.78, 0.785, 0.79, 0.795, 0.8, 0.805, 0.81, 0.8150000000000001, 0.8200000000000001, 0.8250000000000001, 0.8300000000000001, 0.835, 0.84, 0.845, 0.85, 0.855, 0.86, 0.865, 0.87, 0.875, 0.88, 0.885, 0.89, 0.895, 0.9, 0.905, 0.91, 0.915, 0.92, 0.925, 0.93, 0.935, 0.9400000000000001, 0.9450000000000001, 0.9500000000000001, 0.9550000000000001, 0.96, 0.965, 0.97, 0.975, 0.98, 0.985, 0.99, 0.995, 1.0},
.temps = {25.0},
.param_2 = {2.99, 3.0, 3.0100000000000002, 3.02, 3.0300000000000002, 3.04, 3.0500000000000003, 3.06, 3.0700000000000003, 3.08, 3.0900000000000003, 3.1, 3.1100000000000003, 3.12, 3.1300000000000003, 3.14, 3.1500000000000004, 3.16, 3.1700000000000004, 3.18, 3.1900000000000004, 3.2, 3.2100000000000004, 3.22, 3.2300000000000004, 3.24, 3.25, 3.2600000000000002, 3.2700000000000005, 3.2800000000000002, 3.29, 3.3000000000000003, 3.31, 3.3200000000000003, 3.33, 3.3400000000000003, 3.35, 3.3600000000000003, 3.37, 3.3800000000000003, 3.39, 3.4000000000000004, 3.41, 3.4200000000000004, 3.43, 3.4400000000000004, 3.45, 3.4600000000000004, 3.47, 3.4800000000000004, 3.49, 3.5, 3.5100000000000002, 3.5200000000000005, 3.5300000000000002, 3.54, 3.5500000000000003, 3.5600000000000005, 3.5700000000000003, 3.58, 3.5900000000000003, 3.6, 3.6100000000000003, 3.62, 3.6300000000000003, 3.64, 3.6500000000000004, 3.66, 3.6700000000000004, 3.68, 3.6900000000000004, 3.7, 3.71, 3.72, 3.7300000000000004, 3.74, 3.75, 3.7600000000000002, 3.7700000000000005, 3.7800000000000002, 3.79, 3.8000000000000003, 3.8100000000000005, 3.8200000000000003, 3.83, 3.8400000000000003, 3.85, 3.8600000000000003, 3.87, 3.8800000000000003, 3.89, 3.9000000000000004, 3.91, 3.9200000000000004, 3.93, 3.9400000000000004, 3.95, 3.96, 3.97, 3.9800000000000004, 3.99, 4.0, 4.01, 4.0200000000000005, 4.03, 4.04, 4.050000000000001, 4.0600000000000005, 4.07, 4.08, 4.09, 4.1000000000000005, 4.11, 4.12, 4.130000000000001, 4.140000000000001, 4.15, 4.16, 4.17, 4.18, 4.19, 4.2},
.param_3 = {0.1008713435358308, 0.11653709026388107, 0.12541922357678234, 0.12962510874812894, 0.1312621110515152, 0.13237617692859635, 0.13370707247241878, 0.1348488266312687, 0.13586403641923467, 0.13683385519209568, 0.1376355747737969, 0.1383087088663562, 0.13890569933290492, 0.13927901836365308, 0.13948224481124588, 0.13971769760740013, 0.13995624304994705, 0.14015254247307873, 0.1403269758923996, 0.1404713792805436, 0.14058732873442162, 0.14073105653622703, 0.14089561572969822, 0.14104466316275585, 0.14124227439556253, 0.1414912223350152, 0.14170196111511554, 0.1419012985873575, 0.14214029841160705, 0.1424111049001236, 0.14269593959752636, 0.14297842337838781, 0.14325376809282137, 0.14352627254602, 0.14380774810137525, 0.14411034902837408, 0.14443931273410424, 0.14478713541401228, 0.14514494262131222, 0.1455056552947907, 0.1458676797323032, 0.14623046616218907, 0.14659342612216036, 0.1469557691711144, 0.1473166391746865, 0.14767549215501466, 0.1480346640360759, 0.1483980454871225, 0.14876901751806884, 0.14914146820337149, 0.1495010362393552, 0.14983327479092337, 0.1501323027045603, 0.1504041261008275, 0.1506556168569436, 0.15089140770302253, 0.15111108030949544, 0.15131352427269476, 0.15149952659525606, 0.15167708118984297, 0.1518558927960764, 0.15204333248001273, 0.15223150713090375, 0.15240638781261498, 0.15255511936084237, 0.15267903260965274, 0.15278877820668557, 0.15289486944330885, 0.1530002530714845, 0.1530999249014163, 0.15318857775952988, 0.15326655200378164, 0.15334370225762858, 0.15343078962131657, 0.15353274995155533, 0.15363835976025028, 0.15373361638909336, 0.1538078441100298, 0.15386607908561847, 0.1539179912679721, 0.15397245044996408, 0.15403171377361266, 0.15409477938013705, 0.15416047440250608, 0.15422529247006583, 0.15428386911306943, 0.15433097197863369, 0.154368162240347, 0.15440563167378035, 0.15445408009912334, 0.15451679384298236, 0.15458183151709426, 0.15463538103555727, 0.1546679935167858, 0.15468520543384923, 0.15469576785475264, 0.15470775796971184, 0.154725285003144, 0.15475101072370484, 0.15478703404928706, 0.15482953400570038, 0.15487113663803678, 0.15490465852974414, 0.15492804250225495, 0.15494416133907765, 0.15495611352629574, 0.15496853311843262, 0.15498841651200626, 0.15502295132047814, 0.15507542389019738, 0.1551393044533392, 0.1552065436637447, 0.15527053434745122, 0.15533081706695204, 0.15538857022548744, 0.15544616174168005, 0.1555147502478439, 0.15560943422801563, 0.15574417702252935, 0.15591705569348777, 0.15611458604082482, 0.15632310744617192, 0.15653155765471885, 0.1567318932243863, 0.15691629294741624, 0.15708251184017377, 0.1572387273468833, 0.15739425911431432, 0.15755781549433376, 0.1577362096642668, 0.1579358886314705, 0.1581611043538446, 0.1584044767792759, 0.15865478742159683, 0.1589017004729535, 0.1591431808356766, 0.15938173453717197, 0.1596196823125767, 0.15985506584907289, 0.1600821594890181, 0.16029510886382944, 0.16048805960492396, 0.1606551573437189, 0.16079056226632749, 0.16089177528297655, 0.16096388026717195, 0.16101300747064187, 0.16104528714511457, 0.16106684954231806, 0.16108382491398066, 0.16110166718336852, 0.16112141367839597, 0.16114232897606717, 0.16116367287683106, 0.1611847051811366, 0.16120468568943264, 0.16122288477083482, 0.16123883485283583, 0.16125234142008188, 0.16126322272680663, 0.16127129702724388, 0.16127638257562732, 0.16127829822099107, 0.16127725630781087, 0.16127454271466424, 0.1612716247057517, 0.1612699695452739, 0.16127104449743138, 0.1612763168264249, 0.1612870467201889, 0.16130283288937633, 0.16132247480222361, 0.1613447668282467, 0.16136850333696143, 0.16139247869788392, 0.16141552502417827, 0.16143778585213994, 0.16146102324948108, 0.16148709930288035, 0.16151787609901647, 0.16155521572456802, 0.1616009802377929, 0.16165690564548207, 0.16172431246892907, 0.1618044357464054, 0.1618985105161828, 0.1620077718165329, 0.16213345468572743, 0.16227684851786928, 0.16243978429159167, 0.16262440380554707, 0.162832852551629, 0.16306727602173116, 0.1633298197077474, 0.16362262910157135, 0.16394784969509665, 0.16430762698021706, 0.16470410644882638, 0.1651394335928181, 0.1656157539040861, 0.166135212874524},
.param_4 = {0.004034853741433232, 0.004661483610555244, 0.005016768943071295, 0.005185004349925158, 0.005250484442060608, 0.005295047077143855, 0.0053482828988967515, 0.005393953065250749, 0.005434561456769388, 0.005473354207683827, 0.005505422990951876, 0.00553234835465425, 0.005556227973316198, 0.005571160734546125, 0.005579289792449836, 0.005588707904296006, 0.005598249721997883, 0.005606101698923151, 0.005613079035695984, 0.005618855171221745, 0.005623493149376865, 0.0056292422614490824, 0.005635824629187929, 0.005641786526510235, 0.0056496909758225015, 0.00565964889340061, 0.005668078444604623, 0.005676051943494301, 0.005685611936464283, 0.005696444196004944, 0.0057078375839010554, 0.005719136935135514, 0.005730150723712855, 0.005741050901840801, 0.005752309924055011, 0.0057644139611349645, 0.005777572509364171, 0.0057914854165604926, 0.00580579770485249, 0.00582022621179163, 0.005834707189292129, 0.005849218646487564, 0.005863737044886416, 0.0058782307668445765, 0.0058926655669874605, 0.005907019686200588, 0.005921386561443038, 0.0059359218194849, 0.005950760700722755, 0.005965658728134861, 0.00598004144957421, 0.005993330991636936, 0.006005292108182412, 0.006016165044033101, 0.006026224674277745, 0.006035656308120903, 0.006044443212379819, 0.006052540970907792, 0.006059981063810243, 0.00606708324759372, 0.006074235711843057, 0.0060817332992005105, 0.006089260285236151, 0.0060962555125046005, 0.006102204774433696, 0.006107161304386111, 0.006111551128267423, 0.006115794777732356, 0.00612001012285938, 0.006123996996056653, 0.006127543110381196, 0.006130662080151267, 0.006133748090305144, 0.006137231584852664, 0.006141309998062215, 0.006145534390410013, 0.006149344655563735, 0.006152313764401192, 0.00615464316342474, 0.006156719650718885, 0.006158898017998565, 0.006161268550944507, 0.006163791175205483, 0.006166418976100244, 0.006169011698802634, 0.006171354764522778, 0.006173238879145349, 0.006174726489613881, 0.006176225266951216, 0.006178163203964935, 0.006180671753719296, 0.006183273260683771, 0.0061854152414222915, 0.006186719740671433, 0.00618740821735397, 0.006187830714190106, 0.006188310318788475, 0.006189011400125761, 0.006190040428948195, 0.0061914813619714845, 0.006193181360228016, 0.006194845465521472, 0.006196186341189767, 0.006197121700090199, 0.006197766453563107, 0.006198244541051831, 0.006198741324737305, 0.006199536660480252, 0.006200918052819126, 0.006203016955607896, 0.006205572178133569, 0.0062082617465497895, 0.00621082137389805, 0.006213232682678083, 0.006215542809019499, 0.006217846469667203, 0.006220590009913756, 0.006224377369120626, 0.006229767080901175, 0.006236682227739512, 0.006244583441632994, 0.006252924297846877, 0.006261262306188755, 0.006269275728975453, 0.00627665171789665, 0.006283300473606952, 0.006289549093875333, 0.0062957703645725735, 0.006302312619773351, 0.006309448386570673, 0.006317435545258821, 0.006326444174153784, 0.006336179071171038, 0.006346191496863875, 0.006356068018918141, 0.006365727233427066, 0.00637526938148688, 0.006384787292503069, 0.006394202633962916, 0.006403286379560725, 0.0064118043545531795, 0.00641952238419696, 0.006426206293748757, 0.0064316224906531, 0.0064356710113190625, 0.006438555210686879, 0.006440520298825676, 0.006441811485804584, 0.006442673981692724, 0.006443352996559227, 0.006444066687334742, 0.006444856547135841, 0.006445693159042688, 0.006446546915073244, 0.006447388207245466, 0.006448187427577307, 0.006448915390833394, 0.006449553394113434, 0.006450093656803276, 0.006450528909072267, 0.006450851881089756, 0.006451055303025094, 0.006451131928839645, 0.006451090252312436, 0.00645098170858657, 0.0064508649882300696, 0.006450798781810957, 0.006450841779897257, 0.006451052673056997, 0.006451481868807557, 0.006452113315575055, 0.006452898992088946, 0.006453790673129869, 0.006454740133478459, 0.0064556991479153576, 0.006456621000967132, 0.006457511434085599, 0.006458440929979244, 0.006459483972115215, 0.0064607150439606595, 0.006462208628982722, 0.006464039209511717, 0.006466276225819285, 0.006468972498757164, 0.006472177429856217, 0.0064759404206473125, 0.006480310872661317, 0.0064853381874290985, 0.006491073940714772, 0.006497591371663668, 0.006504976152221884, 0.00651331410206516, 0.006522691040869248, 0.0065331927883098976, 0.006544905164062855, 0.006557913987803868, 0.0065723050792086835, 0.006588164257953056, 0.0066055773437127254, 0.006624630156163444, 0.006645408514980962},
.param_5 = {0.12532597382440228, 0.09819152016380628, 0.05235207393699147, 0.02337154989893132, 0.011004272721869702, 0.00977984568361432, 0.009890598810689388, 0.00862785578726365, 0.007940114243307813, 0.007086153418248836, 0.0058994146970422524, 0.005080498236432161, 0.003881237989187495, 0.002306181913363809, 0.0017547169749881388, 0.0018959929548046858, 0.0017393794627144563, 0.0014829313698101407, 0.0012753472298594228, 0.0010414113680880938, 0.0010387090227337477, 0.0012331479811064118, 0.0012544265061152464, 0.001386634663457214, 0.0017862366890375285, 0.0018387468782121545, 0.0016403050093690384, 0.0017533491859659904, 0.0020392252510643624, 0.0022225647436772446, 0.002269273913056962, 0.002231313981179966, 0.002191396670528714, 0.0022159200342155953, 0.0023363059294163532, 0.002526258530916037, 0.002707145542552806, 0.0028225195488318887, 0.0028740795231137206, 0.0028909484439638283, 0.0028992434695934016, 0.002902985559428712, 0.0029012120357012686, 0.0028928522101044803, 0.0028788919356011536, 0.002872099445557722, 0.0028902133284312327, 0.0029374139279717514, 0.0029736908649960654, 0.002928074885145439, 0.0027672263502074614, 0.0025250658608202796, 0.0022834052396165753, 0.0020932566095332485, 0.0019491264087801927, 0.0018218538102073717, 0.0016884662786888736, 0.0015537851430424791, 0.0014542276685927842, 0.0014254648032813177, 0.0014650051606790622, 0.0015024573393094057, 0.0014522213304089988, 0.0012944489197545296, 0.0010905791881510307, 0.0009346353833727429, 0.0008633473346245091, 0.0008458994591956787, 0.0008202218324297565, 0.0007532987521816255, 0.0006665084094613534, 0.0006204979923947647, 0.0006569504701396667, 0.000756190775707058, 0.0008302805557349087, 0.0008034657501520756, 0.0006779373991179331, 0.0005298507861004921, 0.000440588631769271, 0.00042548545738244417, 0.00045489002256223973, 0.0004893157206918228, 0.0005150425155736778, 0.0005220523597151104, 0.0004935788422534039, 0.0004227180342714597, 0.0003371725091102888, 0.0002986387805867241, 0.00034367143510538947, 0.00044464867680798006, 0.0005110056718836235, 0.0004743487702995805, 0.00034464799876622945, 0.00019929759316784923, 0.00011109735186731404, 9.021014345045666e-05, 0.00011806859356545615, 0.0001730110159720022, 0.0002469961845723463, 0.0003140931279821055, 0.0003364103549987653, 0.0003004980961751093, 0.000227623456872713, 0.00015801123733399577, 0.00011228409616320309, 9.748711741986923e-05, 0.00012921194284211054, 0.00021767280818209625, 0.00034802951276438274, 0.000465412531444262, 0.0005244790941893313, 0.000524919576448072, 0.0004970936128293781, 0.00047214351214493536, 0.00046137869891193714, 0.000504720089425717, 0.0006530899453423451, 0.0009177070987419038, 0.00123048586188855, 0.001481636073181851, 0.0016242070107365739, 0.0016678864555761189, 0.0016351431128575934, 0.0015389411707895408, 0.0014024744631498456, 0.0012897375978682644, 0.0012469890965621788, 0.0012763525898017679, 0.001367802199809913, 0.0015122925485470604, 0.001699578758311126, 0.0018743525912216438, 0.0019747322710090935, 0.0019888947747103043, 0.001953573656319086, 0.0019201362568738861, 0.00190600590760032, 0.0018933252476036229, 0.0018499087057656169, 0.0017601720590263575, 0.0016236004636235174, 0.0014401939195577904, 0.0012100106456140042, 0.0009464717570305085, 0.0006932720033778553, 0.0004849287506613481, 0.00032562751177047516, 0.00021536828670480276, 0.0001541510754643309, 0.0001392705642018141, 0.00015035505766137353, 0.00016264717079455052, 0.00016903679374031394, 0.0001695048202778049, 0.00016405125040632948, 0.0001527183587928145, 0.00013659665361268752, 0.00011782659698825193, 9.755149588328016e-05, 7.58224286480022e-05, 5.263939528276501e-05, 2.8004774988831665e-05, 3.4949287341760893e-06, -1.5022025307443593e-05, -2.2526408236661633e-05, -1.8292677561333043e-05, -2.3208332812843513e-06, 2.538912460400486e-05, 6.400889103006652e-05, 0.0001060642518057632, 0.00014171232813886547, 0.00016773575548141573, 0.00018411413895127668, 0.000190847478548882, 0.000188086748867302, 0.00018122861702414908, 0.00018199290121121564, 0.00019725380296159098, 0.0002274113981415478, 0.0002724656867507391, 0.0003324165551057967, 0.000406759683656277, 0.0004933289245446539, 0.0005901204036932312, 0.0006967921890148505, 0.0008133442805099457, 0.0009397766781786034, 0.0010763068053454804, 0.0012253184234569704, 0.0013902211507112704, 0.0015722730401492024, 0.0017714888647363432, 0.0019878686244737334, 0.0022214123193606793, 0.0024721199493970072, 0.002739991514582891, 0.0030250270149188505, 0.003327226450404192, 0.0036465898210388294, 0.003983117126823629, 0.0041556717635034615},
.param_6 = {3.1331493456100534, 2.454788004095154, 1.3088018484247872, 0.5842887474732855, 0.2751068180467414, 0.24449614209035853, 0.24726497026723582, 0.21569639468158874, 0.1985028560826968, 0.17715383545622299, 0.14748536742605345, 0.12701245591080212, 0.09703094972968729, 0.05765454783409618, 0.04386792437470477, 0.04739982387011732, 0.04348448656786019, 0.03707328424525369, 0.031883680746486176, 0.02603528420220269, 0.02596772556834326, 0.03082869952766021, 0.03136066265288229, 0.03466586658643078, 0.04465591722593587, 0.04596867195530152, 0.04100762523422952, 0.04383372964915089, 0.050980631276609234, 0.055564118591930334, 0.05673184782642171, 0.055782849529500966, 0.054784916763217506, 0.05539800085538893, 0.058407648235409004, 0.06315646327289814, 0.06767863856382006, 0.07056298872079869, 0.07185198807784232, 0.07227371109909675, 0.07248108673983678, 0.07257463898571737, 0.07253030089253154, 0.07232130525261227, 0.07197229839002728, 0.07180248613894158, 0.07225533321078281, 0.07343534819929387, 0.07434227162489981, 0.07320187212863649, 0.06918065875518853, 0.06312664652050881, 0.057085130990414124, 0.05233141523832974, 0.048728160219502215, 0.04554634525518464, 0.04221165696722262, 0.03884462857606241, 0.03635569171482056, 0.035636620082032944, 0.03662512901697612, 0.03756143348273566, 0.03630553326022523, 0.03236122299386246, 0.027264479703775768, 0.023365884584319874, 0.02158368336561134, 0.02114748647989162, 0.02050554581074504, 0.018832468804538816, 0.016662710236534095, 0.015512449809870765, 0.01642376175349236, 0.018904769392674714, 0.02075701389337159, 0.020086643753802758, 0.016948434977950844, 0.013246269652511522, 0.011014715794230301, 0.010637136434560324, 0.011372250564056774, 0.01223289301729713, 0.01287606288934151, 0.01305130899287854, 0.012339471056335705, 0.010567950856785191, 0.008429312727756266, 0.007465969514666715, 0.00859178587763465, 0.01111621692020115, 0.012775141797091716, 0.01185871925749038, 0.008616199969155303, 0.004982439829195884, 0.0027774337966829377, 0.00225525358626133, 0.0029517148391361436, 0.004325275399300055, 0.006174904614306143, 0.007852328199553504, 0.008410258874971821, 0.0075124524043762575, 0.005690586421816524, 0.003950280933351369, 0.002807102404078776, 0.0024371779354964707, 0.0032302985710525034, 0.005441820204551973, 0.008700737819111737, 0.011635313286106896, 0.01311197735473224, 0.013122989411201713, 0.01242734032073367, 0.011803587803621562, 0.01153446747280129, 0.012618002235645354, 0.0163272486335575, 0.022942677468545947, 0.030762146547214098, 0.037040901829546446, 0.04060517526841556, 0.04169716138940349, 0.04087857782143767, 0.038473529269739126, 0.035061861578747355, 0.03224343994670531, 0.03117472741405447, 0.031908814745046366, 0.034195054995248, 0.037807313713675295, 0.042489468957779275, 0.04685881478053988, 0.0493683067752243, 0.04972236936775787, 0.04883934140797741, 0.048003406421848194, 0.047650147690009304, 0.047333131190091526, 0.046247717644140596, 0.044004301475655816, 0.040590011590585506, 0.03600484798894632, 0.030250266140352533, 0.02366179392576384, 0.017331800084446902, 0.012123218766532662, 0.008140687794261359, 0.005384207167619115, 0.0038537768866087063, 0.003481764105045526, 0.003758876441531389, 0.004066179269865411, 0.004225919843509063, 0.004237620506941653, 0.00410128126015763, 0.0038179589698233984, 0.0034149163403190963, 0.0029456649247056044, 0.0024387873970799223, 0.0018955607162002286, 0.0013159848820692988, 0.0007001193747191437, 8.737321835483591e-05, -0.00037555063268357447, -0.0005631602059158469, -0.00045731693903428017, -5.802083203332309e-05, 0.0006347281151009021, 0.0016002222757521833, 0.0026516062951426056, 0.003542808203471637, 0.004193393887036434, 0.00460285347378131, 0.004771186963722918, 0.0047021687216847186, 0.0045307154256019055, 0.0045498225302809114, 0.004931345074041249, 0.005685284953538261, 0.006811642168766396, 0.00831041387764353, 0.010168992091405538, 0.012333223113616953, 0.014753010092333207, 0.017419804725371524, 0.020333607012748556, 0.023494416954464303, 0.026907670133638484, 0.030632960586424174, 0.034755528767779764, 0.03930682600373214, 0.044287221618408146, 0.04969671561184108, 0.055535307984019844, 0.06180299873492501, 0.06849978786457045, 0.07562567537297282, 0.08318066126010437, 0.09116474552597065, 0.09957792817059108, 0.10389179408758498},
.param_7 = {0.0002642431042786084, 0.00027322119662226483, 0.0002821992889659217, 0.0002911773813095781, 0.0003001554736532348, 0.0003091335659968912, 0.0003181116583405481, 0.0003270897506842045, 0.00033606784302786123, 0.0003450459353715177, 0.0003540240277151745, 0.00036300212005883084, 0.00037198021240248763, 0.00038095830474614415, 0.0003899363970898009, 0.00039891448943345725, 0.0004173782636784937, 0.0004363385086312495, 0.0004552987535840061, 0.00047425899853676193, 0.0004932192434895185, 0.0005121794884422742, 0.000531139733395031, 0.0005500999783477868, 0.0005690602233005433, 0.0005880204682532991, 0.000619439353350513, 0.0006681531596334618, 0.0007168669659164106, 0.0007655807721993575, 0.0008216042406102737, 0.0008931840409905051, 0.0009647638413707335, 0.0010301622753493978, 0.0010900802857913472, 0.0011499982962332993, 0.0012118765844688654, 0.0012817205280829824, 0.001351564471697096, 0.0014243557086321599, 0.0015029055946135282, 0.0015814554805949005, 0.00166293345990069, 0.001745159763745737, 0.001833731089259219, 0.001933198053659266, 0.0020395151592647437, 0.0021579828077962536, 0.002286649634880593, 0.0024346434307978386, 0.0026921155390426024, 0.003044310692319894, 0.003421099562316855, 0.003972516040037824, 0.0044985741999952365, 0.004897830159855389, 0.005263017645808468, 0.005614815982707513, 0.00590344809142936, 0.006185022347185839, 0.006475391320001997, 0.006762335977354766, 0.00702461869660434, 0.007262772276056423, 0.007489142056900608, 0.00771101236795493, 0.007931563775346175, 0.008151492131201562, 0.0083712154240822, 0.008591290131000594, 0.008812416885145674, 0.009034594212652845, 0.00925579161888656, 0.009473396321244462, 0.009687945907207823, 0.009906271033223661, 0.010139897208218127, 0.010403545161027629, 0.010706118740399364, 0.011043383942983435, 0.011429350297739994, 0.011870606703754803, 0.012300650831446287, 0.012780827669587068, 0.013493043968227253, 0.014402058695097272, 0.01523053575490505, 0.01655184183426916, 0.018081534172051193, 0.020899011619116222, 0.022635193231887236, 0.023569948598694018, 0.023995726790934754, 0.024378926740376537, 0.024799532706287188, 0.025300346578640807, 0.02577018020019412, 0.026145610619339205, 0.026470984872783265, 0.026793560948443818, 0.027125841123617357, 0.027462038102590458, 0.0278133625878448, 0.0282207619582814, 0.028894443575583753, 0.03431894766237359, 0.03658365511141304, 0.03735017096831565, 0.03784793866625509, 0.038229646487046895, 0.03854436600596501, 0.038808866920590525, 0.039042891275451165, 0.03925276989268539, 0.039443475012431985, 0.0396189197459851, 0.03978219248888383, 0.03993570723717024, 0.0399361022364217, 0.0399361022364217, 0.0399361022364217, 0.0399361022364217},
.param_8 = {1.0569724171144339e-05, 1.0928847864890595e-05, 1.1287971558636869e-05, 1.1647095252383125e-05, 1.2006218946129396e-05, 1.2365342639875651e-05, 1.2724466333621924e-05, 1.3083590027368182e-05, 1.3442713721114452e-05, 1.380183741486071e-05, 1.4160961108606982e-05, 1.4520084802353236e-05, 1.487920849609951e-05, 1.5238332189845768e-05, 1.559745588359204e-05, 1.5956579577338292e-05, 1.669513054713975e-05, 1.7453540345249983e-05, 1.821195014336025e-05, 1.897035994147048e-05, 1.9728769739580745e-05, 2.0487179537690974e-05, 2.1245589335801244e-05, 2.2003999133911473e-05, 2.276240893202174e-05, 2.3520818730131968e-05, 2.4777574134020525e-05, 2.672612638533848e-05, 2.867467863665643e-05, 3.06232308879743e-05, 3.286416962441095e-05, 3.572736163962021e-05, 3.859055365482935e-05, 4.120649101397592e-05, 4.36032114316539e-05, 4.599993184933198e-05, 4.847506337875463e-05, 5.126882112331931e-05, 5.4062578867883855e-05, 5.697422834528641e-05, 6.011622378454114e-05, 6.325821922379603e-05, 6.65173383960276e-05, 6.98063905498295e-05, 7.334924357036877e-05, 7.732792214637066e-05, 8.158060637058977e-05, 8.631931231185015e-05, 9.146598539522374e-05, 9.738573723191357e-05, 0.00010768462156170412, 0.00012177242769279577, 0.00013684398249267423, 0.000158900641601513, 0.0001799429679998095, 0.0001959132063942156, 0.00021052070583233877, 0.00022459263930830057, 0.00023613792365717446, 0.00024740089388743363, 0.0002590156528000799, 0.0002704934390941907, 0.00028098474786417366, 0.00029051089104225697, 0.00029956568227602437, 0.0003084404947181973, 0.00031726255101384703, 0.0003260596852480625, 0.000334848616963288, 0.00034365160524002384, 0.000352496675405827, 0.0003613837685061139, 0.00037023166475546243, 0.00037893585284977854, 0.000387517836288313, 0.00039625084132894657, 0.00040559588832872516, 0.0004161418064411052, 0.00042824474961597464, 0.00044173535771933745, 0.0004571740119095998, 0.00047482426815019226, 0.0004920260332578516, 0.0005112331067834828, 0.0005397217587290902, 0.0005760823478038909, 0.0006092214301962021, 0.0006620736733707665, 0.0007232613668820479, 0.000835960464764649, 0.0009054077292754896, 0.0009427979439477609, 0.0009598290716373903, 0.0009751570696150617, 0.0009919813082514878, 0.0010120138631456324, 0.001030807208007765, 0.0010458244247735684, 0.0010588393949113309, 0.001071742437937753, 0.0010850336449446944, 0.0010984815241036185, 0.0011125345035137922, 0.001128830478331256, 0.0011557777430233503, 0.0013727579064949438, 0.0014633462044565217, 0.0014940068387326263, 0.0015139175466502039, 0.0015291858594818763, 0.0015417746402386005, 0.0015523546768236214, 0.0015617156510180467, 0.001570110795707416, 0.0015777390004972796, 0.0015847567898394043, 0.0015912876995553534, 0.00159742828948681, 0.0015974440894568685, 0.0015974440894568685, 0.0015974440894568685, 0.0015974440894568685},
.param_9 = {0.5123617998066763},
.param_10 = {67.60951655654536, 0.2897184215679221},
.param_11 = {0.07161047251118428, 0.0015318949803901703},
.param_12 = {0.8410109275625172},
.name = {'1', '4', '5', '0', '0', 's', '8', '0', '0', 'm', 'a', 'h'},
