#include "display.h"

#include <errno.h>
#include <stddef.h>
#include <string.h>
#include <zephyr/drivers/gpio.h>
#include <zephyr/drivers/i2c.h>
#include <zephyr/drivers/regulator.h>
#include <zephyr/kernel.h>
#include <zephyr/sys/byteorder.h>
#include <zephyr/sys/printk.h>
#include <zephyr/types.h>

const char FONT[][6] = {
    {0x00, 0x00, 0x00, 0x00, 0x00, 0x00},  // sp
    {0x00, 0x00, 0x00, 0x2f, 0x00, 0x00},  // !
    {0x00, 0x00, 0x07, 0x00, 0x07, 0x00},  // "
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    {0x00, 0x08, 0x04, 0x08, 0x08, 0x04},  // ~
};

#define LCD_DISP_OFF 0xAE
#define LCD_DISP_ON 0xAF

const uint8_t init_sequence[] = {
    // Initialization Sequence
    LCD_DISP_OFF,  // Display OFF (sleep mode)
    0x20,
    0b00,  // Set Memory Addressing Mode
    // 00=Horizontal Addressing Mode; 01=Vertical Addressing Mode;
    // 10=Page Addressing Mode (RESET); 11=Invalid
    0xB0,  // Set Page Start Address for Page Addressing Mode, 0-7
    0xC0,  // Set COM Output Scan Direction
    0x00,  // --set low column address
    0x10,  // --set high column address
    0x40,  // --set start line address
    0x81,
    0xFF,  // Set contrast control register
    0xA0,  // Set Segment Re-map. A0=address mapped; A1=address 127 mapped.
    0xA6,  // Set display mode. A6=Normal; A7=Inverse
    0xA8,
    0x3F,  // Set multiplex ratio(1 to 64)
    0xA4,  // Output RAM to Display
    // 0xA4=Output follows RAM content; 0xA5,Output ignores RAM content
    0xD3,
    0x00,  // Set display offset. 00 = no offset
    0xD5,  // --set display clock divide ratio/oscillator frequency
    0b11110000,  // --set divide ratio
    0xD9,
    0x22,  // Set pre-charge period
    0xDA,
    0x12,  // Set com pins hardware configuration
    0xDB,  // --set vcomh
    0x20,  // 0x20,0.77xVcc
    0x8D,
    0x14,  // Set DC-DC enable
    LCD_DISP_ON,
};

#define I2C21_NODE DT_NODELABEL(display)
static const struct i2c_dt_spec dev_i2c = I2C_DT_SPEC_GET(I2C21_NODE);
static const struct device *disp_ldsw =
    DEVICE_DT_GET(DT_NODELABEL(npm1300_ek_ldo1));


static struct {
    uint8_t x;
    uint8_t y;
} cursorPosition;

uint8_t displayBuffer[DISPLAY_HEIGHT/8][DISPLAY_WIDTH];

void init_i2c(void) {
    while (!device_is_ready(dev_i2c.bus)) {
        printk("I2C bus %s is not ready\n", dev_i2c.bus->name);
        k_sleep(K_MSEC(100));
    };
}

int lcd_command(const uint8_t *cmds, size_t len) {
    struct i2c_msg mode_msg;
    uint8_t is_command = 0x00;
    mode_msg.buf = &is_command;
    mode_msg.len = 1;
    mode_msg.flags = I2C_MSG_WRITE;

    struct i2c_msg data_msg;
    data_msg.buf = (uint8_t *)cmds;
    data_msg.len = len;
    data_msg.flags = I2C_MSG_WRITE | I2C_MSG_STOP;

    struct i2c_msg msgs[] = {mode_msg, data_msg};
    int ret = i2c_transfer(dev_i2c.bus, msgs, 2, dev_i2c.addr);
    if (ret != 0) {
        printk("Error %d: failed to write command to the display\n", ret);
    }
    return ret;
}

int lcd_data(const uint8_t *data, size_t len) {
    struct i2c_msg mode_msg;
    uint8_t is_data = 0x40;
    mode_msg.buf = &is_data;
    mode_msg.len = 1;
    mode_msg.flags = I2C_MSG_WRITE;

    struct i2c_msg data_msg;
    data_msg.buf = (uint8_t *)data;
    data_msg.len = len;
    data_msg.flags = I2C_MSG_WRITE | I2C_MSG_STOP;

    struct i2c_msg msgs[] = {mode_msg, data_msg};
    int ret = i2c_transfer(dev_i2c.bus, msgs, 2, dev_i2c.addr);
    if (ret != 0) {
        printk("Error %d: failed to write data to the display\n", ret);
    }
    return ret;
}

void lcd_goto_xpix_y(uint8_t x, uint8_t y) {
    cursorPosition.x = x;
    cursorPosition.y = y;
}

void lcd_gotoxy(uint8_t x, uint8_t y) {
    x = x * sizeof(FONT[0]);
    lcd_goto_xpix_y(x, y);
}

void lcd_send_goto_xpix_y(uint8_t x, uint8_t y) {
    cursorPosition.x = x;
    cursorPosition.y = y;
    uint8_t commandSequence[] = {0x22, y, 0x07, 0x21, x, 0x7f};
    lcd_command(commandSequence, sizeof(commandSequence));
}

void lcd_send_home_command() {
    lcd_send_goto_xpix_y(0, 0);
}

void lcd_putc(char c) {
    // mapping char
    c -= ' ';
    for (uint8_t i = 0; i < sizeof(FONT[0]); i++) {
        // load bit-pattern from flash
        displayBuffer[cursorPosition.y][cursorPosition.x + i] =
            FONT[(uint8_t)c][i];
    }
    cursorPosition.x += sizeof(FONT[0]);
}

void lcd_puts(const char *s) {
    while (*s) {
        if (*s == '\n') {
            cursorPosition.x = 0;
            cursorPosition.y++;
            lcd_goto_xpix_y(cursorPosition.x, cursorPosition.y);
        } else {
            lcd_putc(*s);
        }
        s++;
    }
}

void lcd_clear_buffer() {
    for (uint8_t i = 0; i < DISPLAY_HEIGHT / 8; i++) {
        memset(displayBuffer[i], 0x00, sizeof(displayBuffer[i]));
    }
}

void lcd_display() {
    lcd_send_home_command();
    lcd_data(&displayBuffer[0][0], DISPLAY_WIDTH * DISPLAY_HEIGHT / 8);
}

bool display_enabled(void) { return regulator_is_enabled(disp_ldsw); }

void enable_display(void) {
    // Don't enable display if it is already enabled
    // (register keeps the value and would enable it again the next time it's
    // disabled)
    if (!display_enabled()) {
        int ret = regulator_enable(disp_ldsw);
        if (ret != 0) {
            printk("Error %d: failed to enable display LDO\n", ret);
        }
    }
}

void disable_display(void) {
    if (display_enabled()) {
        int ret = regulator_disable(disp_ldsw);
        if (ret != 0) {
            printk("Error %d: failed to disable display LDO\n", ret);
        }
    }
}

void display_init(void) {
    lcd_clear_buffer();
    enable_display();
    k_msleep(50);
    init_i2c();

    int ret = lcd_command(init_sequence, sizeof(init_sequence));
    if (ret != 0) {
        printk("Error %d: failed to write to the display\n", ret);
    }
    k_msleep(50);  // Wait for display to turn on
    lcd_display();
}

void lcd_drawPixel(uint8_t x, uint8_t y, uint8_t color){
    if( color == WHITE){
        displayBuffer[(y / (DISPLAY_HEIGHT/8))][x] |= (1 << (y % (DISPLAY_HEIGHT/8)));
    } else {
        displayBuffer[(y / (DISPLAY_HEIGHT/8))][x] &= ~(1 << (y % (DISPLAY_HEIGHT/8)));
    }
}

void lcd_display_block(uint8_t x, uint8_t line, uint8_t width) {
    if (line > (DISPLAY_HEIGHT/8-1) || x > DISPLAY_WIDTH - 1){return;}
    if (x + width > DISPLAY_WIDTH) { // no -1 here, x alone is width 1
        width = DISPLAY_WIDTH - x;
    }
    lcd_send_goto_xpix_y(x,line);
    lcd_data(&displayBuffer[line][x], width);
}