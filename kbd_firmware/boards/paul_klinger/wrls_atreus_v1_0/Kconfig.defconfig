## kbd_firmware/boards/paul_klinger/wrls_atreus_v1_0/Kconfig.defconfig
```kconfig
if BOARD_WRLS_ATREUS_V1_0_CPUAPP

config ROM_START_OFFSET
	default 0x800 if BOOTLOADER_MCUBOOT

config BT_CTLR
	default BT


CONFIG_REGULATOR=y
CONFIG_SENSOR=y

endif # BOARD_WRLS_ATREUS_V1_0_CPUAPP
```

## kbd_firmware/boards/paul_klinger/wrls_atreus_v1_0/Kconfig.wrls_atreus_v1_0
```kconfig
config BOARD_WRLS_ATREUS_V1_0
	select SOC_NRF54L15_CPUAPP if BOARD_WRLS_ATREUS_V1_0_NRF54L15_CPUAPP
	select SOC_NRF54L15_CPUFLPR if \
		BOARD_WRLS_ATREUS_V1_0_NRF54L15_CPUFLPR || \
		BOARD_WRLS_ATREUS_V1_0_NRF54L15_CPUFLPR_XIP
```

## kbd_firmware/boards/paul_klinger/wrls_atreus_v1_0/board.yml
```yaml
board:
  name: wrls_atreus_v1_0
  vendor: paul_klinger
  socs:
  - name: nrf54l15
    variants:
    - name: xip
      cpucluster: cpuflpr
```
